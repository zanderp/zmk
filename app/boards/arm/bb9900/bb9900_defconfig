## app/boards/arm/bb9900/bb9900_defconfig
```kconfig
# Copyright (c) 2023 ZitaoTech
# SPDX-License-Identifier: MIT

CONFIG_SOC_SERIES_NRF52X=y
CONFIG_SOC_NRF52840_QIAA=y
CONFIG_BOARD_BB9900=y


# Enable MPU
CONFIG_ARM_MPU=y

CONFIG_PINCTRL=y

# enable GPIO
CONFIG_GPIO=y

# Build Configuration
CONFIG_USE_DT_CODE_PARTITION=y
CONFIG_BUILD_OUTPUT_UF2=y

# Flash configuration
CONFIG_MPU_ALLOW_FLASH_WRITE=y
CONFIG_NVS=y
CONFIG_SETTINGS_NVS=y
CONFIG_FLASH=y
CONFIG_FLASH_PAGE_LAYOUT=y
CONFIG_FLASH_MAP=y

# Enable Signal Power Plus
CONFIG_BT_CTLR_TX_PWR_PLUS_8=y

# Sleep Setting
CONFIG_ZMK_SLEEP=n
CONFIG_ZMK_EXT_POWER=y
CONFIG_ZMK_IDLE_TIMEOUT=30000

# Indicator for Layerone Setting
CONFIG_ZMK_INDICATOR_LAYERONE=y
CONFIG_ZMK_INDICATOR_LAYERONE_ON_START=y
CONFIG_ZMK_INDICATOR_LAYERONE_BRT_START=60
CONFIG_ZMK_INDICATOR_LAYERONE_AUTO_OFF_SWITCH_LAYERONE=y




# LED indicator configuration
CONFIG_ZMK_HID_INDICATORS=y

# Enable Mouse Emulation
CONFIG_ZMK_MOUSE=y

# Debuncing Setting 
CONFIG_ZMK_KSCAN_DEBOUNCE_PRESS_MS=10
CONFIG_ZMK_KSCAN_DEBOUNCE_RELEASE_MS=10

# Enable both USB and BLE
CONFIG_ZMK_USB=y
CONFIG_ZMK_BLE=y

# Log via USB or Segger RTT
CONFIG_ZMK_USB_LOGGING=y
```

## app/boards/arm/bbcase/Kconfig.board
```kconfig
# Copyright (c) 2023 ZitaoTech
# SPDX-License-Identifier: MIT

config BOARD_BBCASE
    bool "bbpcase"
    depends on SOC_RP2040
```

## app/boards/arm/bbcase/Kconfig.defconfig
```kconfig
# Copyright (c) 2023 The ZMK Contributors
# SPDX-License-Identifier: Apache-2.0

if BOARD_BBCASE

config BOARD
	default "bbcase"

config RP2_FLASH_W25Q080
	default y

config ZMK_USB
	default y

endif # BOARD_BBCASE
```

## app/boards/arm/bbcase/bbcase_defconfig
```kconfig
# Copyright (c) 2023 The ZMK Contributors
# SPDX-License-Identifier: MIT

CONFIG_SOC_SERIES_RP2XXX=y
CONFIG_SOC_RP2040=y
CONFIG_BOARD_BBCASE=y
CONFIG_SYS_CLOCK_HW_CYCLES_PER_SEC=240000000

# Enable USB CDC ACM logging for debugging
CONFIG_ZMK_USB_LOGGING=n

# Sleep Setting
CONFIG_ZMK_SLEEP=n
CONFIG_ZMK_EXT_POWER=y
CONFIG_ZMK_IDLE_TIMEOUT=30000



# Debuncing Setting 
CONFIG_ZMK_KSCAN_DEBOUNCE_PRESS_MS=10
CONFIG_ZMK_KSCAN_DEBOUNCE_RELEASE_MS=10

# HID indicator configuration
CONFIG_ZMK_HID_INDICATORS=y


# Enable reset by default
CONFIG_RESET=y

# Code partition needed to target the correct flash range
CONFIG_USE_DT_CODE_PARTITION=y

# Output UF2 by default, native bootloader supports it.
CONFIG_BUILD_OUTPUT_UF2=y

CONFIG_ZMK_USB=y
```

## app/boards/arm/corne-ish_zen/corne-ish_zen_right_defconfig
```kconfig
#
# Copyright (c) 2021 Darryl deHaan
# SPDX-License-Identifier: MIT
#

CONFIG_SOC_SERIES_NRF52X=y
CONFIG_SOC_NRF52840_QIAA=y
#CONFIG_SOC_DCDC_NRF52X=y
CONFIG_BOARD_CORNEISH_ZEN_RIGHT=y
#CONFIG_ZMK_SPLIT_BLE_ROLE_PERIPHERAL=y
CONFIG_ZMK_SLEEP=y
CONFIG_ZMK_DISPLAY=y

# Enable MPU
CONFIG_ARM_MPU=y

# enable GPIO
CONFIG_GPIO=y

# Enable I2C
CONFIG_I2C=y
CONFIG_I2C_NRFX=y
CONFIG_I2C_0=y

# Enable SPI
CONFIG_SPI=y
CONFIG_SPI_2=y
CONFIG_SPI_NRFX=y

# Enable writing to flash
CONFIG_USE_DT_CODE_PARTITION=y
CONFIG_MPU_ALLOW_FLASH_WRITE=y
CONFIG_NVS=y
CONFIG_SETTINGS_NVS=y
CONFIG_FLASH=y
CONFIG_FLASH_PAGE_LAYOUT=y
CONFIG_FLASH_MAP=y

# Enable 32kHz crystal
CONFIG_CLOCK_CONTROL_NRF_K32SRC_XTAL=y
CONFIG_CLOCK_CONTROL_NRF_K32SRC_30PPM=y

# Enable TI BQ27421 Fuel Gauge
CONFIG_SENSOR=y
CONFIG_BQ274XX=y

# enable display drivers
CONFIG_SSD1306=n
CONFIG_IL0323=y
CONFIG_LVGL_HOR_RES_MAX=80
CONFIG_LVGL_VER_RES_MAX=128
CONFIG_LVGL_BITS_PER_PIXEL=1
CONFIG_LVGL_COLOR_DEPTH_1=y
CONFIG_LVGL_DPI=145
CONFIG_LVGL_VDB_SIZE=32
CONFIG_LVGL_USE_THEME_MONO=y
# CONFIG_DISPLAY_WOB=n

# custom status screens
CONFIG_ZMK_DISPLAY_STATUS_SCREEN_CUSTOM=y
CONFIG_CUSTOM_WIDGET_BATTERY_STATUS=y
CONFIG_ZMK_WIDGET_BATTERY_STATUS=n
CONFIG_CUSTOM_WIDGET_OUTPUT_STATUS=y
CONFIG_ZMK_WIDGET_OUTPUT_STATUS=n
```

## app/module/drivers/sensor/Kconfig
```kconfig
# Copyright (c) 2020 The ZMK Contributors
# SPDX-License-Identifier: MIT

if SENSOR

rsource "battery/Kconfig"
rsource "ec11/Kconfig"
rsource "max17048/Kconfig"
rsource "trackpad9900/Kconfig"
rsource "a320/Kconfig"

endif # SENSOR
```

## app/module/drivers/sensor/a320/Kconfig
```kconfig
menuconfig INPUT_A320
    bool "A320 touchpad Driver"
    depends on I2C
    help
      Enable driver for A320
config INPUT_A320_POLLINGRATE
	int "POLLING RATE"
	default 400
	help
	  set the polling rate of a320
```

## app/module/drivers/sensor/trackpad9900/Kconfig
```kconfig
# Copyright (c) 2022 The ZMK Contributors
# SPDX-License-Identifier: MIT

menuconfig TRACKPAD9900
	bool "Blackberry 9900 trackpads"
	depends on GPIO
	depends on I2C
	help
	  Enable driver for blackberry9900 trackpads

if TRACKPAD9900

choice
	prompt "Trigger mode"
	default TRACKPAD9900_TRIGGER_NONE
	help
	  Specify the type of triggering to be used by the driver.

config TRACKPAD9900_TRIGGER_NONE
	bool "No trigger"

config TRACKPAD9900_TRIGGER_GLOBAL_THREAD
	bool "Use global thread"
	depends on GPIO
	select TRACKPAD9900_TRIGGER

config TRACKPAD9900_TRIGGER_OWN_THREAD
	bool "Use own thread"
	depends on GPIO
	select TRACKPAD9900_TRIGGER

endchoice

config TRACKPAD9900_TRIGGER
	bool

config TRACKPAD9900_THREAD_PRIORITY
	int "Thread priority"
	depends on TRACKPAD9900_TRIGGER_OWN_THREAD
	default 10
	help
	  Priority of thread used by the driver to handle interrupts.

config TRACKPAD9900_THREAD_STACK_SIZE
	int "Thread stack size"
	depends on TRACKPAD9900_TRIGGER_OWN_THREAD
	default 1024
	help
	  Stack size of thread used by the driver to handle interrupts.

endif # TRACKPAD9900
```

## app/module/dts/bindings/sensor/blackberry,9900trackpad.yaml
```yaml
description: |
  Sensor driver for the blackberry9900 trackpad, using the I2C interface

compatible: "blackberry,9900trackpad"

include: ["i2c-device.yaml", "base.yaml"]
```

## app/src/studio/Kconfig
```kconfig
menuconfig ZMK_STUDIO
    bool "Studio Support"
    select NANOPB
    help
      Add firmware support for realtime keymap updates (ZMK Studio

if ZMK_STUDIO

menu "Interfaces"

config ZMK_STUDIO_INTERFACE_UART
    bool "Serial"
    select SERIAL
    select NET_BUF
    default y if ZMK_USB

config ZMK_STUDIO_INTERFACE_BLE
    bool "BLE (GATT)"
    select NET_BUF
    depends on ZMK_BLE
    default y

endmenu

endif
```
